/**
 * @cliArgs --board "/boards/LAUNCHXL_F28379D" --device "F2837xD" --part "F2837xD_337ZWT" --package "F2837xD_337ZWT" --context "CPU1" --product "C2000WARE@5.04.00.00"
 * @versions {"tool":"1.21.0+3721"}
 */

/**
 * Import the modules used in this configuration.
 */
const cla    = scripting.addModule("/driverlib/cla.js", {}, false);
const cla1   = cla.addInstance();
const memcfg = scripting.addModule("/driverlib/memcfg.js");
const CMD    = scripting.addModule("/utilities/cmd_tool/cmd_syscfg/source/CMD", {}, false);
const CMD1   = CMD.addInstance();

/**
 * Write custom configuration values to the imported modules.
 */
cla1.$name             = "myCLA0";
cla1.enable_CLA_TASK_2 = false;
cla1.enable_CLA_TASK_4 = false;
cla1.enable_CLA_TASK_3 = false;
cla1.enable_CLA_TASK_5 = false;
cla1.enable_CLA_TASK_6 = false;
cla1.enable_CLA_TASK_7 = false;
cla1.enable_CLA_TASK_8 = false;
cla1.cpuint_CLA_TASK_2 = false;
cla1.cpuint_CLA_TASK_3 = false;
cla1.cpuint_CLA_TASK_5 = false;
cla1.cpuint_CLA_TASK_6 = false;
cla1.cpuint_CLA_TASK_7 = false;
cla1.cpuint_CLA_TASK_8 = false;
cla1.cpuint_CLA_TASK_4 = false;

memcfg.init_MEMCFG_SECT_MSGCPUTOCLA1 = true;
memcfg.init_MEMCFG_SECT_MSGCLA1TOCPU = true;
memcfg.config_MEMCFG_SECT_LS1        = "CLA_data";
memcfg.config_MEMCFG_SECT_LS4        = "CLA_prog";
memcfg.config_MEMCFG_SECT_LS5        = "CLA_prog";

CMD1.$name                         = "CMD0";
CMD1.sectionMemory_cla1ToCpuMsgRAM = ["CLATOCPU_MSGRAM"];
CMD1.sectionMemory_cpuToCla1MsgRAM = ["CPUTOCLA_MSGRAM"];
CMD1.sectionMemory_cla1Prog        = ["RAMLS5"];
CMD1.sectionMemory_claConst        = ["RAMLS1"];
CMD1.sectionMemory_claScratchpad   = ["RAMLS1"];
scripting.suppress("Memcfg module must be enabled for complete error checking\\.", CMD1, "sectionMemory_cpuToCla1MsgRAM");
